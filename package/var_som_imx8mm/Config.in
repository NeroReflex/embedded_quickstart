## package/var_som_imx8mm/Config.in
```kconfig
config BR2_PACKAGE_VAR_SOM_IMX8MM
	bool "Variscite SoM i-MX8M Mini"
    select BR2_PACKAGE_VARISCITE
	select BR2_PACKAGE_HOST_IMX_MKIMAGE_POST
	depends on BR2_PACKAGE_SYSTEMD
	help
		Enable features specific to the Variscite i.MX8M Mini SoM
```

## package/variscite/Config.in
```kconfig
config BR2_PACKAGE_VARISCITE
	bool "Variscite support"
	select BR2_PACKAGE_BRCM_PATCHRAM_PLUS
	select BR2_PACKAGE_LIBGPIOD2
	depends on BR2_PACKAGE_SYSTEMD && (BR2_PACKAGE_RIPGREP || BR2_PACKAGE_GREP)
	help
		Enable hardware support for Variscite products
```
