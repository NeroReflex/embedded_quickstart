## package/qtquickdesigner-components/Config.in
```kconfig
config BR2_PACKAGE_QTQUICKDESIGNER_COMPONENTS
	bool "qtquickdesigner-components"
	depends on BR2_PACKAGE_QT6
	select BR2_PACKAGE_QT6BASE
    select BR2_PACKAGE_QT6DECLARATIVE 
	depends on BR2_USE_MMU # fork()
	help
		QtQuick Designer Studio components: useful if you used qt studio designer to create the GUI.
```
