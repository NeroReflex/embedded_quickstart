## Config.in
```kconfig
menu "Embedded Quickstart"
	source "$BR2_EXTERNAL_EMBEDDED_QUICKSTART_PATH/package/Config.in"
endmenu
```

## meta-embedded_quickstart/conf/layer.conf
```bitbake
# We have a conf and classes directory, add to BBPATH
BBPATH .= ":${LAYERDIR}"

# We have recipes-* directories, add to BBFILES
BBFILES += "${LAYERDIR}/recipes-*/*/*.bb \
            ${LAYERDIR}/recipes-*/*/*.bbappend"

BBFILE_COLLECTIONS += "meta-embedded_quickstart"
BBFILE_PATTERN_meta-embedded_quickstart = "^${LAYERDIR}/"
BBFILE_PRIORITY_meta-embedded_quickstart = "30"

LAYERDEPENDS_meta-embedded_quickstart = "variscite-bsp"
LAYERSERIES_COMPAT_meta-embedded_quickstart = "scarthgap"
```

## package/Config.in
```kconfig
menu "Embedded Quickstart Packages"
    source "$BR2_EXTERNAL_EMBEDDED_QUICKSTART_PATH/package/nano_lts/Config.in"
	source "$BR2_EXTERNAL_EMBEDDED_QUICKSTART_PATH/package/stupid1/Config.in"
	source "$BR2_EXTERNAL_EMBEDDED_QUICKSTART_PATH/package/atomrootfsinit/Config.in"
	source "$BR2_EXTERNAL_EMBEDDED_QUICKSTART_PATH/package/rust_coreutils/Config.in"
	source "$BR2_EXTERNAL_EMBEDDED_QUICKSTART_PATH/package/greetd/Config.in"
	source "$BR2_EXTERNAL_EMBEDDED_QUICKSTART_PATH/package/agreety/Config.in"
	source "$BR2_EXTERNAL_EMBEDDED_QUICKSTART_PATH/package/login_ng-session/Config.in"
	source "$BR2_EXTERNAL_EMBEDDED_QUICKSTART_PATH/package/login_ng-cli/Config.in"
	source "$BR2_EXTERNAL_EMBEDDED_QUICKSTART_PATH/package/login_ng-ctl/Config.in"
	source "$BR2_EXTERNAL_EMBEDDED_QUICKSTART_PATH/package/login_ng-ctl/Config.in.host"
	source "$BR2_EXTERNAL_EMBEDDED_QUICKSTART_PATH/package/pam_login_ng/Config.in"
	source "$BR2_EXTERNAL_EMBEDDED_QUICKSTART_PATH/package/rustdesk/Config.in"
	source "$BR2_EXTERNAL_EMBEDDED_QUICKSTART_PATH/package/imx-atf/Config.in"
	source "$BR2_EXTERNAL_EMBEDDED_QUICKSTART_PATH/package/imx-mkimage-post/Config.in.host"
	source "$BR2_EXTERNAL_EMBEDDED_QUICKSTART_PATH/package/mender_modules/Config.in"
	source "$BR2_EXTERNAL_EMBEDDED_QUICKSTART_PATH/package/mt376r2v1h0/Config.in"
	source "$BR2_EXTERNAL_EMBEDDED_QUICKSTART_PATH/package/variscite/Config.in"
	source "$BR2_EXTERNAL_EMBEDDED_QUICKSTART_PATH/package/var_som_imx8mm/Config.in"
endmenu

menu "Embedded Quickstart Options"
	source "$BR2_EXTERNAL_EMBEDDED_QUICKSTART_PATH/package/autologin/Config.in"
endmenu
```

## package/agreety/Config.in
```kconfig
config BR2_PACKAGE_AGREETY
	bool "agreety"
	depends on BR2_PACKAGE_GREETD
	select BR2_PACKAGE_HOST_RUSTC
	help
		agreety software to interface with greetd
```

## package/atomrootfsinit/Config.in
```kconfig
config BR2_PACKAGE_ATOMROOTFSINIT
	bool "atomrootfsinit"
	depends on BR2_PACKAGE_HOST_RUSTC_TARGET_ARCH_SUPPORTS
	depends on BR2_USE_MMU # fork()
	help
		atomrootfsinit pre-mounts the rootfs at boot and manages the boot of installed updates.
```

## package/autologin/Config.in
```kconfig
config BR2_PACKAGE_AUTOLOGIN
	bool "autologin"
	select BR2_PACKAGE_LOGIN_NG_CLI
	select BR2_PACKAGE_LOGIN_NG_CTL
	select BR2_PACKAGE_HOST_LOGIN_NG_CTL
	depends on BR2_PACKAGE_SYSTEMD
	help
		Enable the autologin feature. You need an /etc/weston.ini file with weston configuration!!!

menu "Autologin Configurations"

	config BR2_EQ_AUTOLOGIN_USER
	depends on BR2_PACKAGE_AUTOLOGIN
	string "login-ng autologin user"
	help
		The user to autologin: must be a valid username

	config BR2_EQ_AUTOLOGIN_USER_UID
	depends on BR2_PACKAGE_AUTOLOGIN
	string "login-ng autologin user UID"
	help
		The UID of the user to autologin: must be a valid (and unused) UID

	config BR2_EQ_AUTOLOGIN_USER_GID
	depends on BR2_PACKAGE_AUTOLOGIN
	string "login-ng autologin user GID"
	help
		The GID of the user to autologin: must be a valid (and unused) GID

	config BR2_EQ_AUTOLOGIN_MAIN_PASSWORD
	depends on BR2_PACKAGE_AUTOLOGIN
	string "login-ng autologin user's main password"
	help
		The main password for the autologin user: must not contain spaces

	config BR2_EQ_AUTOLOGIN_INTERMEDIATE_PASSWORD
	depends on BR2_PACKAGE_AUTOLOGIN
	string "login-ng autologin user's intermediate password"
	help
		The intermediate password for the autologin user: same restrictions for the main password

	config BR2_EQ_AUTOLOGIN_CMD
	depends on BR2_PACKAGE_AUTOLOGIN
	default /usr/bin/kiosk
	string "login-ng autologin command"
	help
		The command to be run when the autologin account is logged in.

endmenu
```

## package/autologin/Config.in.host
```kconfig
config BR2_PACKAGE_HOST_AUTOLOGIN
	bool "autologin"
	select BR2_PACKAGE_HOST_RUST
	select BR2_PACKAGE_LOGIN_NG_CLI
	help
		enable the autologin feature

menu "Autologin Configurations"
	config BR2_EQ_AUTOLOGIN_USER
	depends on BR2_PACKAGE_HOST_AUTOLOGIN
	string "login-ng autologin user"
	help
		The user to autologin
endmenu
```

## package/greetd/Config.in
```kconfig
config BR2_PACKAGE_GREETD
	bool "greetd"
	depends on BR2_PACKAGE_HOST_RUSTC_TARGET_ARCH_SUPPORTS
	select BR2_PACKAGE_HOST_RUSTC
	depends on BR2_USE_MMU # fork()
	help
		greetd login daemon
```

## package/image/Config.in
```kconfig
config BR2_PACKAGE_IMAGE
	bool "modify image"
	help
		Modify a pre-made image instead of creating a new rootfs

menu "Image Configuration"

	config BR2_EQ_IMAGE_PATH
    depends on BR2_PACKAGE_IMAGE
	string "Path on filesystem"
	help
		filesystem path of the image to modify

	config BR2_EQ_IMAGE_PART
	depends on BR2_PACKAGE_IMAGE
	string "Rootfs Partition Number"
	help
		The Partition number that contains the rootfs

endmenu
```

## package/imx-atf/Config.in
```kconfig
config BR2_PACKAGE_IMX_ATF
	bool "imx-atf"
	help
		ARM Trusted Firmware (i.mx8 variant)

menu "imx-atf configuration"

	config BR2_EQ_IMX_ATF_PLAT
	depends on BR2_PACKAGE_IMX_ATF
	string "imx-atf platform"
	default imx8mm
	help
		The platform name as in PLAT= make parameter

	config BR2_EQ_IMX_ATF_TARGET
	depends on BR2_PACKAGE_IMX_ATF
	string "imx-atf make target"
	default bl31
	help
		The make target

endmenu
```

## package/imx-mkimage-post/Config.in.host
```kconfig
config BR2_PACKAGE_HOST_IMX_MKIMAGE_POST
	bool "imx-mkimage"
	select BR2_PACKAGE_HOST_UBOOT_TOOLS
	select BR2_PACKAGE_HOST_UBOOT_TOOLS_FIT_SUPPORT
	select BR2_PACKAGE_HOST_UBOOT_TOOLS_FIT_SIGNATURE_SUPPORT
	help
		build the u-boot image

menu "imx-mkimage configuration"

	config BR2_EQ_IMX_MKIMAGE_POST_SOC
	depends on BR2_PACKAGE_HOST_IMX_MKIMAGE_POST
	string "imx-mkimage target SoC"
	default iMX8MM
	help
		The platform name as in SOC= make parameter

	config BR2_EQ_IMX_MKIMAGE_POST_SOC_DIR
	depends on BR2_PACKAGE_HOST_IMX_MKIMAGE_POST
	string "imx-mkimage target SoC directory inside imx-mkimage sources"
	default iMX8M
	help
		The directory inside imx-mkimages directory to populate

	config BR2_EQ_IMX_MKIMAGE_POST_TARGET
	depends on BR2_PACKAGE_HOST_IMX_MKIMAGE_POST
	string "imx-mkimage make target"
	default flash_lpddr4_ddr4_evk
	help
		The make target

	config BR2_EQ_IMX_MKIMAGE_POST_DTBS
	depends on BR2_PACKAGE_HOST_IMX_MKIMAGE_POST
	string "imx-mkimage dtbs"
	default "imx8mm-var-dart-dt8mcustomboard.dtb imx8mm-var-som-symphony.dtb"
	help
		The list of dtbs

endmenu
```

## package/imx-mkimage/Config.in.host
```kconfig
config BR2_PACKAGE_HOST_IMX_MKIMAGE
	bool "imx-mkimage"
	help
		build the u-boot image

menu "imx-mkimage configuration"

	config BR2_EQ_IMX_MKIMAGE_SOC
	depends on BR2_PACKAGE_HOST_IMX_MKIMAGE
	string "imx-mkimage target SoC"
	default IMX8MM
	help
		The platform name as in SOC= make parameter

	config BR2_EQ_IMX_MKIMAGE_TARGET
	depends on BR2_PACKAGE_HOST_IMX_MKIMAGE
	string "imx-mkimage make target"
	default flash_evk
	help
		The make target

endmenu
```

## package/init/Config.in
```kconfig
config BR2_PACKAGE_INIT
	bool "init"
	depends on BR2_PACKAGE_HOST_RUSTC_TARGET_ARCH_SUPPORTS
	select BR2_PACKAGE_HOST_RUSTC
	depends on BR2_USE_MMU # fork()
	help
		Simple init binary
	
config BR2_EXTERNAL_INIT_PATH
	string "init host path (sources)"
	depends on BR2_PACKAGE_INIT
```

## package/login_ng-cli/Config.in
```kconfig
config BR2_PACKAGE_LOGIN_NG_CLI
	bool "login_ng-cli"
	select BR2_PACKAGE_GREETD
	select BR2_PACKAGE_HOST_RUSTC
	help
		login_ng software to interface with greetd
```

## package/login_ng-ctl/Config.in
```kconfig
config BR2_PACKAGE_LOGIN_NG_CTL
	bool "login_ng-ctl"
	select BR2_PACKAGE_GREETD
	select BR2_PACKAGE_HOST_RUSTC
	help
		login_ng software to manage user authentications
```

## package/login_ng-ctl/Config.in.host
```kconfig
config BR2_PACKAGE_HOST_LOGIN_NG_CTL
	bool "Host login_ng-ctl"
	select BR2_PACKAGE_HOST_RUST
	select BR2_PACKAGE_LOGIN_NG_CLI
	help
		Host login_ng-ctl to edit user properties when building the image
```

## package/login_ng-session/Config.in
```kconfig
config BR2_PACKAGE_LOGIN_NG_SESSION
	bool "login_ng-session"
	select BR2_PACKAGE_GREETD
	select BR2_PACKAGE_HOST_RUSTC
	help
		login_ng-session software to manage user session once opened
```

## package/login_ng/Config.in
```kconfig
config BR2_PACKAGE_LOGIN_NG
	bool "login-ng"
	depends on BR2_PACKAGE_GREETD
	select BR2_PACKAGE_HOST_RUSTC
	help
		login-ng software to interface with greetd
```

## package/monder_modules/Config.in
```kconfig
config BR2_PACKAGE_MENDER_MODULES
	bool "Mender Modules"
	select BR2_PACKAGE_MENDER
	help
		Modules for mender updates
```

## package/mt376r2v1h0/Config.in
```kconfig
config BR2_PACKAGE_MT376R2V1H0
	bool "mt376r2v1h0"
	select BR2_PACKAGE_LIBGPIOD2
	depends on BR2_PACKAGE_SYSTEMD
	help
		Enable features specific to mt376r2v1h0 board
```

## package/nano_lts/Config.in
```kconfig
config BR2_PACKAGE_NANO_LTS
	bool "nano"
	depends on BR2_USE_WCHAR
	# full version uses fork()
	select BR2_PACKAGE_NANO_LTS_TINY if !BR2_USE_MMU
	select BR2_PACKAGE_NCURSES
	help
	  A nice ncurses-based editor. Started out as a clone of pico.
	  Great editor for new users.

	  https://www.nano-editor.org/

if BR2_PACKAGE_NANO

config BR2_PACKAGE_NANO_LTS_TINY
	bool "optimize for size"
	default y
	help
	  Disable all features for the sake of size.

endif

comment "nano needs a toolchain w/ wchar"
	depends on !BR2_USE_WCHAR
```

## package/pam_login_ng/Config.in
```kconfig
config BR2_PACKAGE_PAM_LOGIN_NG
	bool "pam_login_ng"
	select BR2_PACKAGE_LINUX_PAM
	select BR2_PACKAGE_DBUS_BROKER
	help
		login_ng module for linux-pam to allow autologin and secondary authentication methods
```

## package/rust_coreutils/Config.in
```kconfig
config BR2_PACKAGE_RUST_COREUTILS
	bool "rust_coreutils"
	depends on BR2_PACKAGE_LINUX_PAM
	help
		rust uutils coreutils reimplementation in rust
```

## package/rustdesk/Config.in
```kconfig
config BR2_PACKAGE_RUSTDESK
	bool "rustdesk"
	select BR2_PACKAGE_HOST_RUSTC
    select BR2_PACKAGE_LIBVPX
	help
		Remote desktop software
```

## package/stupid1/Config.in
```kconfig
config BR2_PACKAGE_STUPID1
	bool "stuPID1"
	depends on BR2_PACKAGE_HOST_RUSTC_TARGET_ARCH_SUPPORTS
	select BR2_PACKAGE_HOST_RUSTC
	depends on BR2_USE_MMU # fork()
	help
		stuPID1 is the smallest possible PID1 implementation.
```
